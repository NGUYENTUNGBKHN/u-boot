## configs/robotun_stm32_defconfig
```kconfig
CONFIG_ARM=y
CONFIG_CC_OPTIMIZE_FOR_DEBUG=y
CONFIG_OF_LIVE=y
CONFIG_ARCH_STM32=y
CONFIG_TEXT_BASE=0x08000000
CONFIG_SYS_MALLOC_LEN=0x100000
CONFIG_NR_DRAM_BANKS=1
CONFIG_HAS_CUSTOM_SYS_INIT_SP_ADDR=y
CONFIG_CUSTOM_SYS_INIT_SP_ADDR=0x20050000
CONFIG_ENV_SIZE=0x2000
CONFIG_DEFAULT_DEVICE_TREE="st/stm32f746-disco"
CONFIG_SYS_LOAD_ADDR=0x08008000
CONFIG_STM32F7=y
CONFIG_TARGET_STM32F746_DISCO=y
CONFIG_BOOTDELAY=3
CONFIG_USE_BOOTARGS=y
CONFIG_BOOTARGS="console=ttySTM0,115200 earlyprintk consoleblank=0"
# CONFIG_DISPLAY_CPUINFO is not set
# CONFIG_CMD_SETEXPR is not set
CONFIG_OF_CONTROL=y
CONFIG_MTD=y
CONFIG_DM_MTD=y
CONFIG_MTD_NOR_FLASH=y
CONFIG_STM32_FLASH=y
CONFIG_DEBUG_UART=y
CONFIG_DEBUG_UART_STM32=y
CONFIG_DEBUG_UART_BASE=0x40011400
CONFIG_DEBUG_UART_CLOCK=216000000
```
